/*
 * DT-Overlay für Atmel's AT24 und kompatible I2C-EEPROM's
 */

/dts-v1/;
/plugin/;
/include/ "i2c-buses.dtsi"

/{
    compatible = "brcm,bcm2835";

    fragment@0 {
        target = <&i2cbus>;
        __overlay__{
            #address-cells = <1>;
            #size-cells = <0>;
            status="okay";

            eeprom: eeprom@0 {
                pagesize = <1>;
                num-addresses = <1>;
                reg = <0x50>;
                status="okay";
            };
        };
    };
    
    __overrides__ {
    type = <&eeprom>, "compatible";
    addr = <&eeprom>, "reg:0";
    pagesize = <&eeprom>,"pagesize:0";
    wp = <&eeprom>,"read-only?";
    };
};
